## sdkconfig.defaults
```kconfig
# Bootloader and Flash Config
CONFIG_ESPTOOLPY_FLASHMODE_QIO=y
CONFIG_ESPTOOLPY_FLASHFREQ_80M=y
CONFIG_ESPTOOLPY_FLASHSIZE_16MB=y

# Enable PSRAM
CONFIG_SPIRAM=y
CONFIG_SPIRAM_SPEED_200M=y
CONFIG_SPIRAM_FETCH_INSTRUCTIONS=y
CONFIG_SPIRAM_RODATA=y
CONFIG_SPIRAM_XIP_FROM_PSRAM=y

# CPU and FreeRTOS
CONFIG_FREERTOS_HZ=1000
CONFIG_ESP_MAIN_TASK_STACK_SIZE=32768
CONFIG_ESP32P4_REV_MIN_1=y

# LVGL 9 core settings
CONFIG_LV_OS_FREERTOS=y
CONFIG_LV_USE_CLIB_MALLOC=y
CONFIG_LV_USE_CLIB_STRING=y
CONFIG_LV_USE_CLIB_SPRINTF=y
CONFIG_LV_DEF_REFR_PERIOD=15
CONFIG_LV_OBJ_STYLE_CACHE=y
CONFIG_LV_DRAW_SW_DRAW_UNIT_CNT=2
# LCD Type
CONFIG_BSP_LCD_TYPE_480_800_4_3_INCH_A=y

# Waveshare 4.3 inch LCD
CONFIG_BSP_LCD_TYPE_480_800_4_3_INCH_A=y

# Chip Revision v1.3
CONFIG_ESP_REV_MIN_FULL=100
CONFIG_ESP32P4_REV_MIN_1=y
CONFIG_ESP32P4_SELECTS_REV_LESS_V3=y

# Custom Partition Table (larger app partition for Wi-Fi + Web Server)
CONFIG_PARTITION_TABLE_CUSTOM=y
CONFIG_PARTITION_TABLE_CUSTOM_FILENAME="partitions.csv"
```
